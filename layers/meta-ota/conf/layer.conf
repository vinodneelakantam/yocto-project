## layers/meta-ota/conf/layer.conf
```bitbake
# Yocto layer configuration: meta-ota

BBPATH .= ":${LAYERDIR}"
BBFILES += "${LAYERDIR}/recipes-*/*/*.bb ${LAYERDIR}/recipes-*/*/*.bbappend"

BBFILE_COLLECTIONS += "ota"
BBFILE_PATTERN_ota := "^${LAYERDIR}/"
BBFILE_PRIORITY_ota = "10"

LAYERSERIES_COMPAT_ota = "kirkstone langdale mickledore nanbield scarthgap"
```

## layers/meta-portfolio/conf/layer.conf
```bitbake
# Yocto layer configuration: meta-portfolio

BBPATH .= ":${LAYERDIR}"
BBFILES += "${LAYERDIR}/recipes-*/*/*.bb ${LAYERDIR}/recipes-*/*/*.bbappend"

BBFILE_COLLECTIONS += "portfolio"
BBFILE_PATTERN_portfolio := "^${LAYERDIR}/"
BBFILE_PRIORITY_portfolio = "8"

LAYERSERIES_COMPAT_portfolio = "kirkstone langdale mickledore nanbield scarthgap"
```

## layers/meta-security/conf/layer.conf
```bitbake
# Yocto layer configuration: meta-security

BBPATH .= ":${LAYERDIR}"
BBFILES += "${LAYERDIR}/recipes-*/*/*.bb ${LAYERDIR}/recipes-*/*/*.bbappend"

BBFILE_COLLECTIONS += "security"
BBFILE_PATTERN_security := "^${LAYERDIR}/"
BBFILE_PRIORITY_security = "9"

LAYERSERIES_COMPAT_security = "kirkstone langdale mickledore nanbield scarthgap"
```
